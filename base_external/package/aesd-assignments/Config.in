## base_external/package/aesd-assignments/Config.in
```kconfig
config BR2_PACKAGE_AESD_ASSIGNMENTS

    bool "aesd-assignments"

help
      Pull AESD assignment 3-and-later repo and install writer/finder scripts and conf.
```
